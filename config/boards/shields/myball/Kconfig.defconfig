## config/boards/shields/myball/Kconfig.defconfig
```kconfig
if SHIELD_MYBALL_LEFT

config ZMK_KEYBOARD_NAME
    default "MyBall Left"

# ロータリーエンコーダ (EC11) を使うために必要
config EC11
    default y

config EC11_TRIGGER_GLOBAL_THREAD
    default y

endif # SHIELD_MYBALL_LEFT

if SHIELD_MYBALL_RIGHT

config ZMK_KEYBOARD_NAME
    default "MyBall Right"

# トラックボール(PMW3610)を使うために必要
config SPI
    default y

config INPUT
    default y

config ZMK_POINTING
    default y

config PMW3610_ALT
    default y

endif # SHIELD_MYBALL_RIGHT

if SHIELD_MYBALL_LEFT || SHIELD_MYBALL_RIGHT

config ZMK_SPLIT
    default y

endif
```

## config/boards/shields/myball/Kconfig.shield
```kconfig
config SHIELD_MYBALL_LEFT
    def_bool $(shields_list_contains,myball_left)

config SHIELD_MYBALL_RIGHT
    def_bool $(shields_list_contains,myball_right)
```

## config/west.yml
```yaml
manifest:
  remotes:
    - name: zmkfirmware
      url-base: https://github.com/zmkfirmware
    - name: badjeff
      url-base: https://github.com/badjeff
  projects:
    - name: zmk
      remote: zmkfirmware
      revision: main
      import: app/west.yml
    # PMW3610 トラックボールセンサー用ドライバー (badjeff/zmk-pmw3610-driver)
    - name: zmk-pmw3610-driver
      remote: badjeff
      revision: main
  self:
    path: config
```
